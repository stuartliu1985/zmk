## app/boards/shields/28Split-0/REF/Kconfig.defconfig
```kconfig
if SHIELD_28SPLIT_LEFT

config ZMK_KEYBOARD_NAME
    default "28Split"

config ZMK_SPLIT_ROLE_CENTRAL
    default y

endif

if SHIELD_28SPLIT_LEFT || SHIELD_28SPLIT_RIGHT

config ZMK_SPLIT
    default y

endif
```

## app/boards/shields/28Split/Kconfig.shield
```kconfig
# Copyright (c) 2022 Stuart LIU
# SPDX-License-Identifier: MIT

config SHIELD_28SPLIT_LEFT
    def_bool $(shields_list_contains,28split_left)

config SHIELD_28SPLIT_RIGHT
    def_bool $(shields_list_contains,28split_right)
```

## app/boards/shields/28Split_rev2/Kconfig.defconfig
```kconfig
if SHIELD_28SPLIT_LEFT || SHIELD_28SPLIT_REV2_LEFT

config ZMK_KEYBOARD_NAME
    default "28Split"

config ZMK_SPLIT_ROLE_CENTRAL
    default y

endif

if SHIELD_28SPLIT_REV2_LEFT || SHIELD_28SPLIT_REV2_RIGHT

config ZMK_SPLIT
    default y

endif
```

## app/boards/shields/28Split_rev2/Kconfig.shield
```kconfig
# Copyright (c) 2022 Stuart LIU
# SPDX-License-Identifier: MIT

config SHIELD_28SPLIT
    bool

config SHIELD_28SPLIT_LEFT
	def_bool $(shields_list_contains,28split_left)
	select SHIELD_28SPLIT

config SHIELD_28SPLIT_RIGHT
	def_bool $(shields_list_contains,28split_right)
	select SHIELD_28SPLIT

config SHIELD_28SPLIT_REV2_LEFT
	def_bool $(shields_list_contains,28split_rev2_left)
	select SHIELD_28SPLIT

config SHIELD_28SPLIT_REV2_RIGHT
	def_bool $(shields_list_contains,28split_rev2_right)
	select SHIELD_28SPLIT
```

## app/boards/shields/28Uni/Kconfig.shield
```kconfig
# Copyright (c) 2022 Stuart LIU
# SPDX-License-Identifier: MIT

config SHIELD_28UNI
    def_bool $(shields_list_contains,28uni)
```
